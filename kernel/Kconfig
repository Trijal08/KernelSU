## kernel/Kconfig
```kconfig
menu "KernelSU"

config KSU
	tristate "KernelSU function support"
	depends on OVERLAY_FS
	default y
	help
	  Enable kernel-level root privileges on Android System.
	  To compile as a module, choose M here: the
	  module will be called kernelsu.

config KSU_DEBUG
	bool "KernelSU debug mode"
	depends on KSU
	default n
	help
	  Enable KernelSU debug mode.

menu "KernelSU - SUSFS"

config KSU_SUSFS
	bool "KernelSU addon - SUSFS"
	depends on KSU
	default y
	help
	  An addon root hiding service for KernelSU.

config KSU_SUSFS_SUS_MOUNT
	bool "Hide suspicious mounts"
	depends on KSU_SUSFS
	default y
	help
	  Allow hiding user-defined mount points from
	  /proc/self/mount*, effective on all processes. Mount
	  points from processes in KSU domain are assigned the
	  dev name "KSU".

config KSU_SUSFS_AUTO_ADD_DEFAULT_MOUNT
	bool "Hide KSU's default mount points (experimental)"
	depends on KSU_SUSFS_SUS_MOUNT
	default y
	help
	  Automatically add KSU's default mount points to
	  sus_mount, no userspace interaction required. Only
	  mount points from processes in KSU domain will be
	  checked.

config KSU_SUSFS_AUTO_ADD_BIND_MOUNT
	bool "Hide suspicious bind mounts (experimental)"
	depends on KSU_SUSFS_SUS_MOUNT
	default y
	help
	  Automatically add binded mounts to sus_mount, no
	  userspace interaction required. Only mount points from
	  processes in KSU domain will be checked.

config KSU_SUSFS_TRY_UMOUNT
	bool "Integrate with KSU's try_umount"
	depends on KSU_SUSFS
	default y
	help
	  Allow using try_umount on other user-defined mount
	  points prior to KSU's default umount paths, effective
	  on all non-root processes.

config KSU_SUSFS_AUTO_ADD_TRY_UMOUNT
	bool "Add bind mounts to KSU's try_umount (experimental)"
	depends on KSU_SUSFS_TRY_UMOUNT
	default y
	help
	  Automatically add binded mounts to KSU's try_umount,
	  no userspace interaction required. Only mount points
	  from processes in KSU domain will be checked.
      
config KSU_SUSFS_ENABLE_LOG
	bool "Enable SUSFS kernel logging"
	depends on KSU_SUSFS
	default y
	help
	  Allow SUSFS kernel logging, select 'n' to disable.

config KSU_SUSFS_HIDE_KALLSYMS
	bool "Hide KSU and SUSFS symbols from /proc/kallsyms"
	depends on KSU_SUSFS
	default y
	help
	  Automatically hide KSU and SUSFS symbols from
	  '/proc/kallsyms', effective on all processes.

config KSU_SUSFS_SPOOF_BOOTCONFIG
	bool "Spoof /proc/bootconfig"
	depends on KSU_SUSFS
	default y
	help
	  Allow spoofing the output of /proc/bootconfig with
	  user-defined values, effective on all processes.

endmenu

endmenu
```
